## conf/layer.conf
```bitbake
# We have a conf and classes directory, append to BBPATH
BBPATH .= ":${LAYERDIR}"

# We have a recipes directory, add to BBFILES
BBFILES += "${LAYERDIR}/recipes-*/*/*.bb ${LAYERDIR}/recipes-*/*/*.bbappend"

BBFILE_COLLECTIONS += "kolibre-layer"
BBFILE_PATTERN_kolibre-layer := "^${LAYERDIR}/"
BBFILE_PRIORITY_kolibre-layer = "7"

PREFERRED_PROVIDER_libevent ?= "libevent"
```
